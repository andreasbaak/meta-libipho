## conf/distro/libipho.conf
```bitbake
DISTRO_NAME = "Libipho - Linux-based individual photobooth"
DISTRO_VERSION = "1.0"

PREFERRED_PROVIDER_jpeg = "libjpeg-turbo"
PREFERRED_PROVIDER_virtual/jpeg = "libjpeg-turbo"


DISTRO_FEATURES_remove = " 3g alsa bluetooth irda nfc nfs pulseaudio wayland wifi x11 zeroconf"
```

## conf/layer.conf
```bitbake
# We have a conf and classes directory, append to BBPATH
BBPATH .= ":${LAYERDIR}"

BBFILES += "${LAYERDIR}/recipes-*/*/*.bb ${LAYERDIR}/recipes-*/*/*.bbappend"
BBFILE_COLLECTIONS += "libipho"
BBFILE_PATTERN_libipho := "^${LAYERDIR}/"
BBFILE_PRIORITY_libipho = "5"
```
